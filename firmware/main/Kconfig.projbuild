## firmware/main/Kconfig.projbuild
```kconfig
menu "open-california firmware (#154)"

    config CALI_QEMU_PROBE
        bool "QEMU build: no BT controller init, kvprobe console command"
        default n
        help
            For the QEMU boot tier only (firmware/qemu/sdkconfig.qemu, CI job firmware-qemu); never
            in the release image (a POST_BUILD check in firmware/CMakeLists.txt fails a build
            without this option whose ELF contains "kvprobe").

            1. Skips nimble_port_init(): QEMU does not model the BT controller, and
               esp_bt_controller_init() asserts there (btdm_low_power_mode_init, "assert(select_src_ret
               && set_div_ret)"), rebooting in a loop. The firmware then takes its no-controller path
               ("LOG ble: controller unavailable", console on a refusing transport, idle STATE).
            2. Adds the console command "kvprobe set <hex>" / "kvprobe get", which stores/reads one
               record through cali_kv_set/cali_kv_get (the bond store's NVS path) so the QEMU test
               can prove NVS survives a reboot.

    config CALI_QEMU_ETH
        bool "QEMU build: the OTA path over QEMU's Ethernet (open_eth) to a local release server"
        depends on CALI_QEMU_PROBE
        default n
        select ETH_USE_OPENETH
        help
            For the QEMU tier's OTA test only (tests/firmware/test_qemu_ota.py). With WiFi off
            (CALI_WIFI=n), app_main brings up QEMU's OpenCores Ethernet MAC with DHCP from QEMU's
            user network ("LOG eth: up <ip>") and starts the OTA task on it, so "ota check|install"
            reach the release server CALI_OTA_URL_FMT names. Nothing else runs on this network.

    config CALI_OTA_URL_FMT
        string "QEMU build: the release URL format (empty: GitHub)"
        depends on CALI_QEMU_PROBE
        default ""
        help
            printf format of the release directory, %s = the channel (cali_ota.h CALI_OTA_URL_FMT),
            e.g. "http://10.0.2.2:8070/esp-%s/" (QEMU's user network reaches the host as 10.0.2.2).
            Only the QEMU probe build can set it, so the release image always fetches from GitHub.

    config CALI_WIFI
        bool "WiFi: the station/setup-hotspot runtime and the HTTP page (cali_net on esp_wifi)"
        default y
        help
            With it, platform/esp/net_esp.c implements cali_net on esp_wifi + esp_netif + lwIP
            sockets + mdns, and app_main starts the WiFi runner, the captive DNS and the web
            endpoints. Without it (firmware/qemu/sdkconfig.qemu: QEMU's esp32s3 has no WiFi radio),
            no esp_wifi call is compiled: cali_net_esp_init() returns -1, app_main logs
            "LOG wifi: driver unavailable" once and the WiFi SM stays WIFI_UNPROVISIONED (the QEMU
            test test_no_wifi_driver_boots_and_serves_nothing). A release image whose esp_wifi_init
            fails takes the same path at run time.

endmenu
```
