## firmware/components/cali_display/Kconfig
```kconfig
menu "calictl status display"
    config CALI_DISPLAY
        bool "Show device / WiFi / camper status on the CoreS3 screen"
        default y
        help
            Board package espressif/m5stack_core_s3 + LVGL. Off in the QEMU build (no screen).

    config CALI_DISPLAY_LANG_EN
        bool "English screen texts (default: German)"
        depends on CALI_DISPLAY
        default n
        help
            Texts come from firmware/web/strings.json (EN + DE), as on the web page.

    config CALI_DISPLAY_FORCE_FAIL
        bool "Test only: make display init fail"
        depends on CALI_DISPLAY
        default n
        help
            Test only. cali_display_init logs "display: unavailable (forced)" and returns -1 before
            touching I2C, to exercise the no-screen path on a board that has one. Never ship it.
endmenu
```

## firmware/main/Kconfig.projbuild
```kconfig
menu "open-california firmware (#154)"

    config CALI_QEMU_PROBE
        bool "QEMU build: no BT controller init, kvprobe console command"
        default n
        help
            For the QEMU boot tier only (firmware/qemu/sdkconfig.qemu, CI job firmware-qemu); never
            in the release image (a POST_BUILD check in firmware/CMakeLists.txt fails a build
            without this option whose ELF contains "kvprobe").

            1. Skips nimble_port_init(): QEMU does not model the BT controller, and
               esp_bt_controller_init() asserts there (btdm_low_power_mode_init, "assert(select_src_ret
               && set_div_ret)"), rebooting in a loop. The firmware then takes its no-controller path
               ("LOG ble: controller unavailable", console on a refusing transport, idle STATE).
            2. Adds the console command "kvprobe set <hex>" / "kvprobe get", which stores/reads one
               record through cali_kv_set/cali_kv_get (the bond store's NVS path) so the QEMU test
               can prove NVS survives a reboot.

    config CALI_WIFI
        bool "WiFi: the station/setup-hotspot runtime and the HTTP page (cali_net on esp_wifi)"
        default y
        help
            With it, platform/esp/net_esp.c implements cali_net on esp_wifi + esp_netif + lwIP
            sockets + mdns, and app_main starts the WiFi runner, the captive DNS and the web
            endpoints. Without it (firmware/qemu/sdkconfig.qemu: QEMU's esp32s3 has no WiFi radio),
            no esp_wifi call is compiled: cali_net_esp_init() returns -1, app_main logs
            "LOG wifi: driver unavailable" once and the WiFi SM stays WIFI_UNPROVISIONED (the QEMU
            test test_no_wifi_driver_boots_and_serves_nothing). A release image whose esp_wifi_init
            fails takes the same path at run time.

endmenu
```
